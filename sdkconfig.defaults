## sdkconfig.defaults
```kconfig
#
# CoinGate ESP32 SDK configuration defaults
#

CONFIG_IDF_TARGET="esp32"
CONFIG_ESP_WIFI_ENABLED=y
CONFIG_ESP_WIFI_STA_ENABLED=y
CONFIG_ESP_WIFI_SOFTAP_ENABLED=y
CONFIG_ESP_EVENT_LOOP_PROFILING=y
CONFIG_NVS_ENABLE=y
CONFIG_ESP_NETIF=y
CONFIG_ESP_NETIF_TCPIP_ADAPTER_COMPATIBLE_LAYER=y
CONFIG_SPIFFS=y
```
